#include <SPI.h>
#include <RF24.h>
#include <U8g2lib.h>
#include <Arduino.h>
U8G2_SSD1306_128X64_NONAME_F_HW_I2C u8g2(U8G2_R0, U8X8_PIN_NONE);

//Définition des pin d'entrée
#define BUTTON_PIN A1
#define PIN_TENSION A0
// SDK --> A5
// SDA --> A4

#define PIN_CE  9
#define PIN_CSN 10

#define tunnel  "PIPE1"

RF24 radio(PIN_CE, PIN_CSN);

const byte adresse[6] = tunnel; // Adresse du récepteur, doit correspondre à l'adresse de l'émetteur
unsigned long packetsSentByTransmitter = 0;
unsigned long packetsReceived = 0;

#define POLICE_PRINCIPALE u8g2_font_osb18_tn
#define POLICE_CHIFFRES u8g2_font_lubR18_tr
#define POLICE_PETITE u8g2_font_profont11_mr

//Pour générer un bitmap, ouvrir l'image avec GIMP et l'exporter en .xbm
static const unsigned char Engine[] PROGMEM = {
  0x00, 0x00, 0x00, 0x00, 0x00, 0x00, 0x00, 0x00, 0x00, 0x00, 0x00, 0x00,
  0x00, 0xe0, 0x7f, 0x00, 0x00, 0x60, 0x60, 0x00, 0x00, 0x20, 0x40, 0x00,
  0x00, 0xe0, 0x79, 0x00, 0x00, 0x00, 0x09, 0x00, 0x00, 0x00, 0x0d, 0x00,
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  0x00, 0x00, 0x00, 0x00, 0x00, 0x00, 0x00, 0x00
};

static const unsigned char Fan[] PROGMEM = {
  0x00, 0x00, 0xc0, 0x07, 0xc0, 0x07, 0xc0, 0x03, 0xc0, 0x01, 0x06, 0x00,
  0x8e, 0x79, 0xde, 0x79, 0xde, 0x79, 0x0e, 0x71, 0x00, 0x60, 0x80, 0x03,
  0xc0, 0x03, 0xe0, 0x03, 0xe0, 0x03, 0x00, 0x00
};

static const unsigned char Load_1[] PROGMEM = { //30x32
   0x00, 0x40, 0x00, 0x00, 0x00, 0xf8, 0x01, 0x00, 0x00, 0xf8, 0x03, 0x00,
   0x00, 0xf8, 0x03, 0x00, 0x00, 0xfc, 0xc3, 0x00, 0x00, 0xf8, 0xe3, 0x01,
   0x00, 0xf8, 0xf1, 0x03, 0x30, 0xf0, 0xf0, 0x03, 0x20, 0x00, 0xf0, 0x03,
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   0x00, 0xf0, 0x00, 0x00, 0x00, 0x20, 0x00, 0x00 
};

static const unsigned char Load_2[] PROGMEM = { //34x32
   0x00, 0x00, 0x00, 0x00, 0x00, 0x00, 0x00, 0x00, 0x00, 0x00, 0x00, 0x80,
   0x01, 0x03, 0x00, 0x00, 0x00, 0xc0, 0x0f, 0x00, 0x00, 0x00, 0xc0, 0x0f,
   0x00, 0x40, 0x00, 0xe0, 0x0f, 0x00, 0xc0, 0x00, 0xe0, 0x0f, 0x00, 0x80,
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   0x00, 0x00, 0x00, 0x00 
};

static const unsigned char Load_3[] PROGMEM = { //35x33
   0x00, 0x00, 0x00, 0x00, 0x00, 0x00, 0x00, 0x00, 0x00, 0x00, 0x00, 0x00,
   0x01, 0x00, 0x00, 0x00, 0x00, 0x03, 0x00, 0x00, 0x00, 0x00, 0x00, 0x00,
   0x00, 0x00, 0x00, 0x00, 0x00, 0x00, 0x80, 0x03, 0x00, 0x02, 0x00, 0xc0,
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   0x00, 0x00, 0x00, 0x00, 0x00, 0x00, 0x00, 0x00, 0x00 
};

static const unsigned char Load_4[] PROGMEM = { //34x35
   0x00, 0x00, 0x00, 0x00, 0x00, 0x00, 0x00, 0x00, 0x00, 0x00, 0x00, 0x00,
   0x00, 0x00, 0x00, 0x00, 0x00, 0x07, 0x00, 0x00, 0x00, 0x00, 0x06, 0x00,
   0x00, 0x00, 0x00, 0x04, 0x00, 0x00, 0x00, 0x03, 0x00, 0x00, 0x00, 0x80,
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   0x00, 0x00, 0x00, 0x00, 0x00, 0x00, 0x00 
};

static const unsigned char Load_5[] PROGMEM = { //35x36
   0x00, 0x00, 0x00, 0x00, 0x00, 0x00, 0x00, 0x00, 0x00, 0x00, 0x00, 0x00,
   0x00, 0x00, 0x00, 0x00, 0x00, 0x04, 0x00, 0x00, 0x00, 0x00, 0x0c, 0x00,
   0x00, 0x00, 0x00, 0x06, 0x00, 0x00, 0x00, 0x00, 0x00, 0x00, 0x00, 0x80,
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   0x00, 0x00, 0x00, 0x00, 0x00, 0x00, 0x00, 0x00, 0x00, 0x00, 0x00, 0x00 
};

static const unsigned char Load_6[] PROGMEM = { //36x34
   0x00, 0x00, 0x00, 0x00, 0x00, 0x00, 0x00, 0x00, 0x00, 0x00, 0x00, 0x00,
   0x00, 0x00, 0x00, 0x00, 0x00, 0x00, 0x00, 0x00, 0x00, 0x00, 0x0e, 0x00,
   0x00, 0x00, 0x00, 0x0e, 0x00, 0x00, 0x00, 0x04, 0x0e, 0x00, 0x00, 0x00,
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   0x00, 0x00 
};

static const unsigned char Load_7[] PROGMEM = { //38x35
   0x00, 0x00, 0x00, 0x00, 0x00, 0x00, 0x00, 0x00, 0x00, 0x00, 0x00, 0x00,
   0x00, 0x00, 0x00, 0x00, 0x00, 0x10, 0x00, 0x00, 0x00, 0x00, 0x7c, 0x00,
   0x00, 0x00, 0x00, 0x3c, 0x00, 0x00, 0x00, 0x00, 0x7e, 0x00, 0x00, 0x00,
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   0x00, 0x00, 0x00, 0x00, 0x00, 0x00, 0x00 
};

static const unsigned char Load_8[] PROGMEM = { //35x37
   0x00, 0x00, 0x00, 0x00, 0x00, 0x00, 0x00, 0x00, 0x00, 0x00, 0x00, 0x00,
   0x00, 0x00, 0x00, 0x00, 0x00, 0x00, 0x00, 0x00, 0x00, 0x00, 0x00, 0x00,
   0x00, 0x00, 0xc0, 0x07, 0x00, 0x00, 0x00, 0x80, 0x07, 0x00, 0x00, 0x80,
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   0x00, 0x00, 0x00, 0x00, 0x00 
};

static const unsigned char thermoMoteur[] PROGMEM = { //26x16
   0x18, 0x00, 0x00, 0x00, 0x24, 0x00, 0x1e, 0x00, 0xe4, 0x00, 0x21, 0x00,
   0x24, 0x00, 0x12, 0x00, 0x34, 0x00, 0x7f, 0x00, 0xf4, 0x80, 0x80, 0x00,
   0x34, 0x6c, 0x88, 0x03, 0x34, 0x34, 0x8c, 0x02, 0x34, 0x24, 0x06, 0x02,
   0x7a, 0x24, 0x0e, 0x02, 0xfd, 0x34, 0x84, 0x02, 0xfd, 0x6c, 0x84, 0x03,
   0xff, 0x80, 0x40, 0x00, 0xff, 0x00, 0x3f, 0x00, 0x7e, 0x00, 0x00, 0x00,
   0x3c, 0x00, 0x00, 0x00 
};

static const unsigned char thermoElectro[] PROGMEM = { //26x16
   0x18, 0x40, 0x29, 0x00, 0x24, 0x40, 0x29, 0x00, 0xe4, 0x00, 0x00, 0x00,
   0x24, 0xe0, 0x7f, 0x00, 0x34, 0xec, 0x7f, 0x03, 0xf4, 0xe0, 0x7f, 0x00,
   0x34, 0x6c, 0x60, 0x03, 0x34, 0x60, 0x60, 0x00, 0x34, 0x60, 0x60, 0x00,
   0x7a, 0x6c, 0x60, 0x03, 0xfd, 0xe0, 0x7f, 0x00, 0xfd, 0xec, 0x7f, 0x03,
   0xff, 0xe0, 0x7f, 0x00, 0xff, 0x00, 0x00, 0x00, 0x7e, 0x40, 0x29, 0x00,
   0x3c, 0x40, 0x29, 0x00 
};

unsigned char* listOfLoad[9] = { Load_2, Load_3, Load_4, Load_5, Load_6, Load_7, Load_8, Load_2, Load_3 };

// Icones reseau
static const unsigned char icon_reseau_1[] PROGMEM = {
   0x00, 0x00, 0x00, 0x00, 0x00, 0x00, 0x00, 0x00, 0x00, 0x00, 0x00, 0x00,
   0x00, 0x00, 0x00, 0x00, 0x00, 0x00, 0x00, 0x00, 0x00, 0x00, 0x00, 0x00,
   0x03, 0x00, 0x07, 0x00, 0x0f, 0x00, 0x0f, 0x00 
};

static const unsigned char icon_reseau_2[] PROGMEM = {
   0x00, 0x00, 0x00, 0x00, 0x00, 0x00, 0x00, 0x00, 0x00, 0x00, 0x00, 0x00,
   0x07, 0x00, 0x1f, 0x00, 0x7f, 0x00, 0xff, 0x00, 0xfc, 0x00, 0xf0, 0x01,
   0xe3, 0x01, 0xe7, 0x03, 0xcf, 0x03, 0xcf, 0x03 
};

static const unsigned char icon_reseau_3[] PROGMEM = {
   0x0f, 0x00, 0x7f, 0x00, 0xff, 0x01, 0xff, 0x03, 0xf8, 0x07, 0xc0, 0x0f,
   0x87, 0x1f, 0x1f, 0x3f, 0x7f, 0x3e, 0xff, 0x7c, 0xfc, 0x78, 0xf0, 0x79,
   0xe3, 0xf9, 0xe7, 0xf3, 0xcf, 0xf3, 0xcf, 0xf3
};

float packetLossPercentage = 0;
int signal = -1;

//Variables pour la reception du signal
int valeur[9];

float vin = 0.0;
int pourcentageBatterie = 0;

//Pour ecran 3
int rpmMax = 0;
int vitesseMax = 0;
int temperatureMax = 0;
float tempsDeRoulage = 0;

void pre(){
  //u8g2.setDrawColor(0);
  u8g2.setFont(POLICE_PETITE);    
  u8g2.setCursor(0,12);
  u8g2.print(F("RC"));
}

void afficherRpmVitesse(){
  u8g2.setDrawColor(1);
  u8g2.setFont(POLICE_CHIFFRES);  
  u8g2.setCursor(0, 38);
  u8g2.print(F("RPM"));
  u8g2.setCursor(0, 64);
  u8g2.print(F("V:"));
}

void afficherKmh(){
  u8g2.setDrawColor(1);
  u8g2.setFont(u8g2_font_6x12_tr);  
  u8g2.setCursor(95, 64);
  u8g2.print(F("Km/h"));
}

void afficherBatterieTemperature(){
  u8g2.setDrawColor(1);
  u8g2.setFont(POLICE_CHIFFRES);  
  //u8g2.drawGlyph(60, 38, 0x00b0);
  u8g2.drawCircle(67, 21, 2, U8G2_DRAW_ALL);
  u8g2.drawCircle(67, 48, 2, U8G2_DRAW_ALL);
  u8g2.drawXBMP(0, 22, 26, 16, thermoMoteur); //Thermometre moteur
  u8g2.drawXBMP(0, 48, 26, 16, thermoElectro); //Thermometre electronique
  /*u8g2.setCursor(0, 38);
  u8g2.print(F("T:"));*/
  /*u8g2.setCursor(75, 38);
  u8g2.print(F("C"));*/
}

void initAffichage1(){
  pre();
  afficherRpmVitesse();
  afficherKmh();
}

void initAffichage2(){
  pre();
  afficherBatterieTemperature();
}

void initAffichage3(){
  pre();
  u8g2.setDrawColor(1);
  u8g2.setFont(u8g2_font_6x12_tr);    
  u8g2.setCursor(0, 24);
  u8g2.print(F("rpmMax :"));
  u8g2.setCursor(0, 37);
  u8g2.print(F("vMax :"));
  u8g2.setCursor(0, 50);
  u8g2.print(F("tempMax :"));
  u8g2.setCursor(0, 63);
  u8g2.print(F("tpsRoulage :"));
}

void afficherSignal1(){
  calculSignal();

  u8g2.setDrawColor(1); 
  u8g2.setFont(u8g2_font_unifont_t_77); 
  u8g2.drawGlyph(18, 15, 9981); //Affiche un icone de pompe à essence
  if (valeur[2] > 50){
    u8g2.drawXBMP(37, 0, 16, 16, Fan); //Ventilo moteur
  }
  if (valeur[6] > 30){
    u8g2.drawXBMP(56, 0, 16, 16, Fan); //Ventilo electronique
  }
  if (valeur[4] == 1){
    u8g2.setFont(u8g2_font_open_iconic_thing_2x_t); 
    u8g2.drawGlyph(75, 16, 67); //Affiche un icone de clef
  }
  if (valeur[0] > 0){
    u8g2.setFont(u8g2_font_open_iconic_embedded_2x_t);
    u8g2.drawGlyph(94, 16, 78); //Affiche un icone de demarrer
  }
  /*u8g2.setFont(u8g2_font_open_iconic_www_2x_t);  
  u8g2.drawGlyph(112, 16, 72); //Affiche un icone de reseau*/

  switch (signal){
    case 1:
      u8g2.drawXBMP(112, 0, 16, 16, icon_reseau_1);
      break;
    
    case 2:
      u8g2.drawXBMP(112, 0, 16, 16, icon_reseau_2);
      break;

    case 3:
      u8g2.drawXBMP(112, 0, 16, 16, icon_reseau_3);
      break;
  }
}

void afficherSignal2(){
  u8g2.setDrawColor(1);
  u8g2.setFont(u8g2_font_open_iconic_check_2x_t);  
  u8g2.drawGlyph(112, 16, 68);  //Affiche une croix pour le reseau
}

void tension(){
  int TensionBatterie = 0;
  // BATTERIE -- Lecture de la tension de la batterie sur le Pin A0
   TensionBatterie = analogRead(PIN_TENSION);
   vin = (TensionBatterie*5.8)/1000; 
   if (vin < 0.09) {
      vin = 0.0;//Déclaration pour annuler la lecture indésirable !
   }
   pourcentageBatterie = ((vin - 4)/(5.8 - 4))*100;

   /*Serial.print(F("Batterie : "));
   Serial.println(vin);*/

  if (pourcentageBatterie > 100){
    pourcentageBatterie = 100;
  }else if(pourcentageBatterie < 0){
    pourcentageBatterie = 0;
  }
}

void afficherTransition(){
  u8g2.setDrawColor(1);
  for (int i = 0; i < 9; i++){
    u8g2.clearBuffer();
    //u8g2.drawXBMP(48, 13, 30, 32, listOfLoad[i]);
    u8g2.drawXBMP(48, 10, 38, 38, listOfLoad[i]);
    u8g2.setFont(POLICE_PETITE);  
    u8g2.setCursor(38,58);
    u8g2.print(F("Chargement"));
    u8g2.sendBuffer();
    delay(50);
  }
}

void afficherEcranDemarrage(){
  u8g2.setDrawColor(1);
  for (int i = 0; i < 25; i++){
    u8g2.clearBuffer();
    u8g2.setFont(POLICE_PETITE);    
    u8g2.setCursor(30,12);
    u8g2.print(F("Trophy Truck"));

    u8g2.setFont(u8g2_font_open_iconic_embedded_2x_t);
    u8g2.drawGlyph(55, 40, 78);

    u8g2.drawFrame(25, 55, i*3, 2);
    u8g2.sendBuffer();
    delay(50);
  }
}

void afficherDemarrage(){
  u8g2.setDrawColor(1);
  u8g2.drawXBMP(48, 19, 32, 32, Engine);
  u8g2.setFont(POLICE_PETITE);  
  u8g2.setCursor(40, 61);
  u8g2.print(F("Demarrage"));
}

void afficherEcran1(){  

  if (!radio.available()) {
    afficherSignal2();
    initAffichage1();
  }else {
    radio.read(&valeur, sizeof(valeur));
    afficherSignal1();
    if (valeur[5] == 1){
      pre();
      afficherDemarrage();
    } else { 
      initAffichage1();
      char text[5];
      if (valeur[0] == 0) {
        strncpy(text, "--", sizeof(text));
      } else {
        sprintf(text, "%d", valeur[0]);  
      }
      u8g2.setCursor(64,38);
      u8g2.setFont(POLICE_PRINCIPALE);  
      u8g2.print(text);

      if (valeur[1] == 0) {
        strncpy(text, "--", sizeof(text));
      } else {
        sprintf(text, "%d", valeur[1]);  
      }
      u8g2.setCursor(35,64);
      u8g2.print(text);
    }
  }
}

void afficherEcran2(){
  tension();

  if (!radio.available()) {
    afficherSignal2();
    initAffichage2();
    afficherBatterie();
  } else {
    radio.read(&valeur, sizeof(valeur));
    afficherSignal1();
    if (valeur[5] == 1){
      pre();
      afficherDemarrage();
    }
    else { 
      initAffichage2();
      afficherBatterie();
      u8g2.setFont(POLICE_PRINCIPALE);
    
      char text[3];
      if (valeur[2] <= -20) {
        strncpy(text, "--", sizeof(text));
      } else {
        sprintf(text, "%d", valeur[2]);  
      }
      u8g2.setCursor(32, 38); 
      u8g2.print(text);

      if (valeur[6] <= -20) {
        strncpy(text, "--", sizeof(text));
      } else {
        sprintf(text, "%d", valeur[6]);  
      }
      u8g2.setCursor(32, 64); 
      u8g2.print(text);
    }
  }
}

void afficherEcran3(){

  if (!radio.available()) {
    afficherSignal2();
    initAffichage3();
    afficherDonnees();
  }else {
    radio.read(&valeur, sizeof(valeur));
    afficherSignal1();
    if (valeur[5] == 1){
      pre();
      afficherDemarrage();
    } else {
      initAffichage3();
      afficherDonnees();
    }
  }
}

void afficherDonnees(){
  u8g2.setFont(u8g2_font_6x12_tr);  

  char text[8];
  if (rpmMax == 0){
    strncpy(text, "--", sizeof(text));
  } else {
    sprintf(text, "%d", rpmMax); 
  }
  u8g2.setCursor(50,24);
  u8g2.print(text);

  if (vitesseMax == 0){
    strncpy(text, "--", sizeof(text));
  } else {
    sprintf(text, "%d", vitesseMax); 
  }
  u8g2.setCursor(40,37);
  u8g2.print(text);

  if (temperatureMax == 0){
    strncpy(text, "--", sizeof(text));
  } else {
    sprintf(text, "%d", temperatureMax); 
  }
  u8g2.setCursor(60,50);
  u8g2.print(text);

  if (tempsDeRoulage == 0){
    strncpy(text, "--", sizeof(text));
  } else {
    sprintf(text, "%d", (char)tempsDeRoulage);
  } 
  /*Serial.print(F("Temps : "));
  Serial.println(text);*/
  u8g2.setCursor(75,63);
  u8g2.print(text);
}

void afficherBatterie(){
  u8g2.setFont(u8g2_font_battery19_tn);
  if (pourcentageBatterie == 0){
    u8g2.drawGlyph(115, 64, 48);
  }else if (pourcentageBatterie > 0 && pourcentageBatterie <= 20){
    u8g2.drawGlyph(115, 64, 49);
  }else if (pourcentageBatterie >= 20 && pourcentageBatterie <= 40){
    u8g2.drawGlyph(115, 64, 50);
  }else if(pourcentageBatterie >= 40 && pourcentageBatterie <= 60){
    u8g2.drawGlyph(115, 64, 51);
  }else if(pourcentageBatterie >= 60 && pourcentageBatterie <= 80){
    u8g2.drawGlyph(115, 64, 52);
  }else if(pourcentageBatterie >= 80 && pourcentageBatterie <= 100){
    u8g2.drawGlyph(115, 64, 53);
  }
  
  if (valeur[3] == 0){
    u8g2.drawGlyph(115, 40, 48);
  }else if (valeur[3] > 0 && valeur[3] <= 20){
    u8g2.drawGlyph(115, 40, 49);
  }else if (valeur[3] >= 20 && valeur[3] <= 40){
    u8g2.drawGlyph(115, 40, 50);
  }else if (valeur[3] >= 40 && valeur[3] <= 60){
    u8g2.drawGlyph(115, 40, 51);
  }else if (valeur[3] >= 60 && valeur[3] <= 80){
    u8g2.drawGlyph(115, 40, 52);
  }else if (valeur[3] >= 80 && valeur[3] <= 100){
    u8g2.drawGlyph(115, 40, 53);
  }
  u8g2.setFont(u8g2_font_streamline_transportation_t);
  u8g2.drawGlyph(83, 40, 53);

  u8g2.setFont(u8g2_font_streamline_phone_t);
  u8g2.drawGlyph(85, 64, 48);
}

void calculDonnees(){
  if (valeur[0] > 0){
    tempsDeRoulage += 0.1;
  }
  if (valeur[0] > rpmMax){
    rpmMax = valeur[0];
  }
  if (valeur[1] > vitesseMax){
    vitesseMax = valeur[1];
  }
  if (valeur[2] > temperatureMax){
    temperatureMax = valeur[2];
  }
}

void calculSignal(){
    // Vérifier si le paquet reçu est un paquet de contrôle
    if (valeur[8] == 500) { // Remplacez 0xFFFFFFFF par une valeur spécifique pour le paquet de contrôle
      // Extrait le nombre de paquets envoyés du paquet de contrôle
      packetsSentByTransmitter = valeur[7];
      /*Serial.print(F("Paquets envoyés : "));
      Serial.print(packetsSentByTransmitter);

      Serial.print(F("  --  Paquets recus : "));
      Serial.println(packetsReceived);*/

      // Calculer le pourcentage de paquets reçus
      //float packetLossPercentage = 100.0 * (1.0 - static_cast<float>(packetsReceived) / packetsSentByTransmitter);
      packetLossPercentage = ((packetsSentByTransmitter - packetsReceived) * 100) / packetsSentByTransmitter;
      if (packetLossPercentage <= 0){
        packetLossPercentage = 0;
      } else if (packetLossPercentage >= 100) {
        packetLossPercentage = 100;
      }
      /*Serial.print(F("Paquets perdus : "));
      Serial.print((int)packetLossPercentage);
      Serial.println(F("%"));*/

      packetsReceived = 0; // On remet à 0
    } else {
      packetsReceived++;
    }

    if((int)packetLossPercentage >= 67 &&  (int)packetLossPercentage < 100){
      signal = 1;
    } else if((int)packetLossPercentage >= 34 &&  (int)packetLossPercentage < 67){
      signal = 2;
    } else if((int)packetLossPercentage >= 0 &&  (int)packetLossPercentage < 34){
      signal = 3;
    }
}

void setup(){
  Serial.begin(9600);
  u8g2.begin();
  u8g2.enableUTF8Print();
  u8g2.setDisplayRotation(U8G2_R2);
  afficherEcranDemarrage();

  // Initialisation du module RF24
  radio.begin();
  radio.openReadingPipe(0, adresse); // Ouvre le canal 1 avec l'adresse de l'émetteur
  radio.setPALevel(RF24_PA_HIGH);
  radio.startListening(); // Démarre l'écoute des données
}

void loop(){
  while (analogRead(BUTTON_PIN) != 0){
    //Serial.println(F("Ecran 1")); //Debug
    u8g2.clearBuffer();
    calculDonnees();
    afficherEcran1();
    u8g2.sendBuffer();
    delay(100);
  }

  delay(500);
  afficherTransition();
  u8g2.clearBuffer();

  while (analogRead(BUTTON_PIN) != 0) {
    //Serial.println(F("Ecran 2")); // Debug
    u8g2.clearBuffer();
    calculDonnees();
    afficherEcran2();
    u8g2.sendBuffer();
    delay(100);
  }

  delay(500);
  afficherTransition();
  u8g2.clearBuffer();

  while (analogRead(BUTTON_PIN) != 0){
    //Serial.println(F("Ecran 3")); //Debug
    u8g2.clearBuffer();
    calculDonnees();
    afficherEcran3();
    u8g2.sendBuffer();
    delay(100);
  }

  delay(500);
  afficherTransition();
  u8g2.clearBuffer();
}